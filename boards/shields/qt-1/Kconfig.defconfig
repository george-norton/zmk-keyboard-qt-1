## boards/shields/qt-1/Kconfig.shield
```kconfig
config SHIELD_QT_1
    def_bool $(shields_list_contains,qt-1)
    select ADC
    select GPIO
    select LED
```

## config/west.yml
```yaml
manifest:
  remotes:
    - name: zmkfirmware
      url-base: https://github.com/zmkfirmware
    - name: george-norton
      url-base: https://github.com/george-norton
  projects:
    - name: zmk
      remote: zmkfirmware
      revision: main
      import: app/west.yml
    - name: zmk-behavior-ble-lego-control
      remote: george-norton
      revision: main
```
